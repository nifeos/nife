/dts-v1/;

/*
 * The JH7110's clock controller **as the vendor U-Boot spells it**, which is the firmware radon
 * actually runs. NOT a dump from any board: transcribed 2026-09-04 from
 * arch/riscv/dts/jh7110.dtsi in starfive-tech/u-boot, branch JH7110_VisionFive2_devel.
 *
 * Three differences from mainline's `stgcrg` are the whole reason this fixture exists. The node
 * has **no unit address** (`clock-controller`, not `clock-controller@10230000`), so a name-prefix
 * read finds nothing useful. The compatible is `starfive,jh7110-clkgen`. And one node carries
 * **three windows**, sys/stg/aon, so the STG base is not `reg[0]`: it is whichever entry
 * `reg-names` calls "stg". Picking window 1 by position would be right here and wrong the moment
 * StarFive reorders the list, which is why `discover` indexes by name.
 *
 * The `clocks`/`clock-names` lists of the real node are dropped: `discover` reads `reg` and
 * `reg-names` only, and phandles to nodes this fixture does not define would not compile.
 *
 * Regenerate with:
 *
 *     dtc -I dts -O dtb -o crates/machine_discovery/tests/fixtures/jh7110-clkgen-vendor.dtb \
 *                          crates/machine_discovery/tests/fixtures/jh7110-clkgen-vendor.dts
 */

/ {
	#address-cells = <2>;
	#size-cells = <2>;
	compatible = "starfive,jh7110";
	model = "StarFive VisionFive V2";

	soc {
		compatible = "simple-bus";
		#address-cells = <2>;
		#size-cells = <2>;
		ranges;

		clock-controller {
			compatible = "starfive,jh7110-clkgen";
			reg = <0x0 0x13020000 0x0 0x10000>,
			      <0x0 0x10230000 0x0 0x10000>,
			      <0x0 0x17000000 0x0 0x10000>;
			reg-names = "sys", "stg", "aon";
			#clock-cells = <1>;
			status = "okay";
		};
	};
};
