/dts-v1/;

/*
 * The JH7110's two SD/MMC controllers as MAINLINE Linux describes them: arch/riscv/boot/dts/
 * starfive/jh7110.dtsi with jh7110-common.dtsi's VisionFive 2 overrides applied, read 2026-10-06
 * (UTC). Only these two nodes; phandles and pinctrl dropped. Compile:
 * dtc -I dts -O dtb -o jh7110-mmc-mainline.dtb jh7110-mmc-mainline.dts
 */

/ {
	#address-cells = <2>;
	#size-cells = <2>;
	compatible = "starfive,visionfive-2-v1.3b", "starfive,jh7110";

	soc {
		compatible = "simple-bus";
		#address-cells = <2>;
		#size-cells = <2>;
		ranges;

		mmc@16010000 {
			compatible = "starfive,jh7110-mmc";
			reg = <0x0 0x16010000 0x0 0x10000>;
			clock-names = "biu", "ciu";
			reset-names = "reset";
			interrupts = <74>;
			fifo-depth = <32>;
			fifo-watermark-aligned;
			data-addr = <0>;
			max-frequency = <100000000>;
			assigned-clock-rates = <50000000>;
			bus-width = <8>;
			status = "okay";
		};

		mmc@16020000 {
			compatible = "starfive,jh7110-mmc";
			reg = <0x0 0x16020000 0x0 0x10000>;
			clock-names = "biu", "ciu";
			reset-names = "reset";
			interrupts = <75>;
			fifo-depth = <32>;
			fifo-watermark-aligned;
			data-addr = <0>;
			max-frequency = <100000000>;
			assigned-clock-rates = <50000000>;
			bus-width = <4>;
			cap-sd-highspeed;
			status = "okay";
		};
	};
};
