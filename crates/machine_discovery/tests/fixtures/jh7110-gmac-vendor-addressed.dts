/dts-v1/;

/*
 * SYNTHETIC, not modeled on any board: a vendor-spelled gmac0 whose `ethernet-phy@0` child
 * states its MDIO address, 3, in `reg`, which the vendor tree radon serves does not. It exists so
 * a test can show that address is read rather than assumed to be 0. Compile with `dtc -I dts -O
 * dtb -o jh7110-gmac-vendor-addressed.dtb jh7110-gmac-vendor-addressed.dts`.
 */

/ {
	#address-cells = <2>;
	#size-cells = <2>;

	soc {
		compatible = "simple-bus";
		#address-cells = <2>;
		#size-cells = <2>;
		ranges;

		ethernet@16030000 {
			compatible = "starfive,jh7110-eqos-5.20";
			reg = <0x0 0x16030000 0x0 0x10000>;
			phy-mode = "rgmii-id";
			#address-cells = <1>;
			#size-cells = <0>;

			ethernet-phy@0 {
				reg = <3>;
				rx_delay_sel = <0xa>;
			};
		};
	};
};
