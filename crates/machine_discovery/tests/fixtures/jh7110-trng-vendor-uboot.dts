/dts-v1/;

/*
 * The JH7110 TRNG node **as the vendor U-Boot spells it**, which is the tree radon actually hands
 * this kernel. NOT a dump from any board: transcribed 2026-09-03 from the firmware's own source,
 * `arch/riscv/dts/jh7110.dtsi` in starfive-tech/u-boot, branch JH7110_VisionFive2_devel, at commit
 * bfbdce9b86a2 (2023-01-06, the last change to that file before the flashed firmware's Feb 12 2023
 * build date; the node is unchanged at that branch's head):
 *
 *     trng: trng@1600C000 {
 *         compatible = "starfive,trng";
 *         reg = <0x0 0x1600C000 0x0 0x4000>;
 *         clocks = <&clkgen JH7110_SEC_HCLK>,
 *              <&clkgen JH7110_SEC_MISCAHB_CLK>;
 *         clock-names = "hclk", "miscahb_clk";
 *         resets = <&rstgen RSTN_U0_SEC_TOP_HRESETN>;
 *         interrupts = <30>;
 *         status = "disabled";
 *     };
 *
 * Four differences from mainline's `rng@1600c000` matter here and all four are why milestone 239
 * exists: the node NAME is `trng@1600C000` (with an upper-case C, which is why the bench's
 * `fdt print /soc/rng@1600c000` on 2026-09-03 answered FDT_ERR_NOTFOUND and would have answered
 * the same for a lower-case `trng@1600c000`), the COMPATIBLE is `starfive,trng`, the STATUS is
 * `disabled`, and the second clock is named `miscahb_clk` rather than mainline's `ahb`.
 *
 * The soc wrapper, its `#address-cells = <2>` / `#size-cells = <2>` and its `ranges` are the real
 * ones, measured off the board and already committed in
 * crates/machine_discovery/tests/fixtures/visionfive2-uboot-control.dts; the four-cell `reg` here
 * only decodes correctly under them, so the wrapper is part of the fixture rather than scenery.
 * The clock and reset phandles are dropped, as jh7110-trng-present.dts drops its own: `discover`
 * reads `reg`, `interrupts` and `status`, and a phandle to a node this fixture does not define
 * would not compile.
 *
 * Regenerate with:
 *
 *     dtc -I dts -O dtb -o crates/machine_discovery/tests/fixtures/jh7110-trng-vendor-uboot.dtb \
 *                          crates/machine_discovery/tests/fixtures/jh7110-trng-vendor-uboot.dts
 */

/ {
	#address-cells = <2>;
	#size-cells = <2>;
	compatible = "starfive,jh7110";
	model = "StarFive VisionFive V2";

	soc {
		compatible = "simple-bus";
		#address-cells = <2>;
		#size-cells = <2>;
		ranges;

		trng@1600C000 {
			compatible = "starfive,trng";
			reg = <0x0 0x1600C000 0x0 0x4000>;
			clock-names = "hclk", "miscahb_clk";
			interrupts = <30>;
			status = "disabled";
		};
	};
};
