/dts-v1/;

/*
 * The watchdog as mainline Linux describes it (milestone 593 (a wedged kernel resets itself),
 * provisional): arch/riscv/boot/dts/starfive/jh7110.dtsi, read 2026-10-20 (UTC). Numbers written
 * out from include/dt-bindings/clock/starfive,jh7110-crg.h and its reset twin:
 * JH7110_SYSCLK_WDT_APB 122, JH7110_SYSCLK_WDT_CORE 123, JH7110_SYSRST_WDT_APB 109,
 * JH7110_SYSRST_WDT_CORE 110.
 *
 * Regenerate with:
 *
 *     dtc -I dts -O dtb -o crates/jh7110_watchdog/tests/fixtures/jh7110-watchdog-mainline.dtb \
 *                          crates/jh7110_watchdog/tests/fixtures/jh7110-watchdog-mainline.dts
 */

/ {
	#address-cells = <2>;
	#size-cells = <2>;
	compatible = "starfive,visionfive-2-v1.3b", "starfive,jh7110";

	soc {
		compatible = "simple-bus";
		#address-cells = <2>;
		#size-cells = <2>;
		ranges;

		syscrg: clock-controller@13020000 {
			compatible = "starfive,jh7110-syscrg";
			reg = <0x0 0x13020000 0x0 0x10000>;
			#clock-cells = <1>;
			#reset-cells = <1>;
		};

		watchdog@13070000 {
			compatible = "starfive,jh7110-wdt";
			reg = <0x0 0x13070000 0x0 0x10000>;
			clocks = <&syscrg 122>, <&syscrg 123>;
			clock-names = "apb", "core";
			resets = <&syscrg 109>, <&syscrg 110>;
		};
	};
};
